## PingPong/main/Kconfig.projbuild
```kconfig
menu "Application Configuration"

    choice POLARITY
        prompt "Communication Polarity"
        default PRIMARY
        help
            Select Communication Polarity.
        config PRIMARY
            bool "Primary"
            help
                As Primary.
        config SECONDARY
            bool "Secondary"
            help
                As Secondary.
    endchoice

endmenu 
```

## components/nRF905/Kconfig.projbuild
```kconfig
menu "nRF905 Configuration"

	config GPIO_RANGE_MAX
		int
		default 33 if IDF_TARGET_ESP32
		default 46 if IDF_TARGET_ESP32S2
		default 48 if IDF_TARGET_ESP32S3
		default 18 if IDF_TARGET_ESP32C2
		default 19 if IDF_TARGET_ESP32C3
		default 30 if IDF_TARGET_ESP32C6

	config MISO_GPIO
		int "MISO GPIO"
		range 0 GPIO_RANGE_MAX
		default 19 if IDF_TARGET_ESP32
		default 37 if IDF_TARGET_ESP32S2 || IDF_TARGET_ESP32S3
		default  4 # C3 and others
		help
			Pin Number to be used as the MISO SPI signal.

	config SCK_GPIO
		int "SCK GPIO"
		range 0 GPIO_RANGE_MAX
		default 18 if IDF_TARGET_ESP32
		default 36 if IDF_TARGET_ESP32S2 || IDF_TARGET_ESP32S3
		default  3 # C3 and others
		help
			Pin Number to be used as the SCK SPI signal.

	config MOSI_GPIO
		int "MOSI GPIO"
		range 0 GPIO_RANGE_MAX
		default 23 if IDF_TARGET_ESP32
		default 35 if IDF_TARGET_ESP32S2 || IDF_TARGET_ESP32S3
		default  2 # C3 and others
		help
			Pin Number to be used as the MOSI SPI signal.

	config CSN_GPIO
		int "CSN GPIO"
		range 0 GPIO_RANGE_MAX
		default  5 if IDF_TARGET_ESP32
		default 34 if IDF_TARGET_ESP32S2 || IDF_TARGET_ESP32S3
		default  1 # C3 and others
		help
			Pin Number where the NCS pin of the LoRa module is connected to.

	config TXEN_GPIO
		int "TXEN GPIO"
		range 0 GPIO_RANGE_MAX
		default 15 if IDF_TARGET_ESP32
		default 40 if IDF_TARGET_ESP32S2 || IDF_TARGET_ESP32S3
		default  5 # C3 and others
		help
			Pin Number to be used as the TX/RX mode switch signal.

	config PWR_GPIO
		int "PWR GPIO"
		range 0 GPIO_RANGE_MAX
		default 16 if IDF_TARGET_ESP32
		default 41 if IDF_TARGET_ESP32S2 || IDF_TARGET_ESP32S3
		default  6 # C3 and others
		help
			Pin Number to be used as the PWR signal.

	config CE_GPIO
		int "CE GPIO"
		range 0 GPIO_RANGE_MAX
		default 17 if IDF_TARGET_ESP32
		default 42 if IDF_TARGET_ESP32S2 || IDF_TARGET_ESP32S3
		default  0 # C3 and others
		help
			Pin Number to be used as the CE signal.

	choice SPI_HOST
		prompt "SPI peripheral that controls this bus"
		default SPI2_HOST
		help
			Select SPI peripheral that controls this bus.
		config SPI2_HOST
			bool "SPI2_HOST"
			help
				Use SPI2_HOST. This is also called HSPI_HOST.
		config SPI3_HOST
			depends on IDF_TARGET_ESP32 || IDF_TARGET_ESP32S2 || IDF_TARGET_ESP32S3
			bool "SPI3_HOST"
			help
				USE SPI3_HOST. This is also called VSPI_HOST
	endchoice

endmenu
```

## mqtt/sdkconfig.defaults
```kconfig
#
# Partition Table
#
CONFIG_PARTITION_TABLE_CUSTOM=y
CONFIG_PARTITION_TABLE_CUSTOM_FILENAME="partitions.csv"
CONFIG_PARTITION_TABLE_FILENAME="partitions.csv"

#
# ESP-MQTT Configurations
#
CONFIG_MQTT_PROTOCOL_5=y
```
